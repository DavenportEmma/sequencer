## software/Kconfig
```kconfig
menu "Sequencer Configuration"

config RESET_SEQ_ON_DISABLE
    bool "reset the step counter on disable"
    default n

config ENABLE_STARTUP_MEMORY_CLEAR
    bool "enable the ability to delete the entire flash memory by holding a key on startup"
    default n

config AUTO_INC_STEP_ON_MIDI_IN
    bool "automatically increment the current step when a midi in packet is received"
    default y

config PLAY_ST_MENU_NOTE
    bool "when stepping through the steps of a sequence, play the note of the step"
    default n

menu "Flash Storage Options"

config METADATA_BASE_ADDR
    int "base address for sequence metadata storage (midi channel/port, prescaer, etc)"
    default 0    

config METADATA_BYTES_PER_SEQ
    int "number of bytes saved for each sequence in the metadata section of flash"
    default 16

config STEPS_BASE_ADDR
    int "base address for sequence step data"
    default 1024

endmenu # Flash Storage Options

endmenu # Sequencer Configuration
```
